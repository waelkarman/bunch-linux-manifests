## meta-bunch-linux/conf/bblayers.conf
```bitbake
# standard
POKY_BBLAYERS_CONF_VERSION = "2"
BBPATH = "${TOPDIR}"
YOCTOROOT = "${@os.path.abspath(os.path.join("${TOPDIR}", os.pardir))}"
BBFILES ?= ""
BBLAYERS = " \
${YOCTOROOT}/poky/meta \
${YOCTOROOT}/poky/meta-poky \
${YOCTOROOT}/poky/meta-yocto-bsp \
${YOCTOROOT}/meta-rauc \ 
${YOCTOROOT}/meta-raspberrypi \
${YOCTOROOT}/meta-bunch-linux \
${YOCTOROOT}/meta-openembedded/meta-filesystems \
${YOCTOROOT}/meta-openembedded/meta-gnome \
${YOCTOROOT}/meta-openembedded/meta-initramfs \
${YOCTOROOT}/meta-openembedded/meta-multimedia \
${YOCTOROOT}/meta-openembedded/meta-networking \
${YOCTOROOT}/meta-openembedded/meta-oe \
${YOCTOROOT}/meta-openembedded/meta-perl \
${YOCTOROOT}/meta-openembedded/meta-python \
${YOCTOROOT}/meta-openembedded/meta-webserver \
${YOCTOROOT}/meta-openembedded/meta-xfce \
"

BBLAYERS ?= " \
    ${TOPDIR}/../boot-doc \
    ${TOPDIR}/../meta-openembedded/meta-filesystems \
    ${TOPDIR}/../meta-openembedded/meta-gnome \
    ${TOPDIR}/../meta-openembedded/meta-initramfs \
    ${TOPDIR}/../meta-openembedded/meta-multimedia \
    ${TOPDIR}/../meta-openembedded/meta-networking \
    ${TOPDIR}/../meta-openembedded/meta-oe \
    ${TOPDIR}/../meta-openembedded/meta-perl \
    ${TOPDIR}/../meta-openembedded/meta-python \
    ${TOPDIR}/../meta-openembedded/meta-webserver \
    ${TOPDIR}/../meta-openembedded/meta-xfce \
    ${TOPDIR}/../meta-raspberrypi \
    ${TOPDIR}/../meta-rauc \
    ${TOPDIR}/../poky/meta \
    ${TOPDIR}/../poky/meta-poky \
    ${TOPDIR}/../poky/meta-yocto-bsp"
BBPATH ?= "${TOPDIR}"
BBFILES ??= ""
```

## meta-bunch-linux/conf/layer.conf
```bitbake
# We have a conf and classes directory, add to BBPATH
BBPATH .= ":${LAYERDIR}"

# We have recipes-* directories, add to BBFILES
BBFILES += "${LAYERDIR}/recipes-*/*/*/*.bb \
            ${LAYERDIR}/recipes-*/*/*.bb \
            ${LAYERDIR}/recipes-*/*.bb \
            ${LAYERDIR}/recipes-*/*/*/*.bbappend \
            ${LAYERDIR}/recipes-*/*/*.bbappend \
            ${LAYERDIR}/recipes-*/*.bbappend"

BBFILE_COLLECTIONS += "meta-bunch-linux"
BBFILE_PATTERN_meta-bunch-linux = "^${LAYERDIR}/"
BBFILE_PRIORITY_meta-bunch-linux = "10"

LAYERDEPENDS_meta-bunch-linux = "core"
LAYERSERIES_COMPAT_meta-bunch-linux = "kirkstone"
```

## meta-bunch-linux/conf/local.conf
```bitbake
# buildinfo
INHERIT += " rm_work"
USER_CLASSES ?= "buildstats"
PATCHRESOLVE = "noop"
BB_DISKMON_DIRS ??= "\
STOPTASKS,${TMPDIR},1G,100K \
STOPTASKS,${DL_DIR},1G,100K \
STOPTASKS,${SSTATE_DIR},1G,100K \
STOPTASKS,/tmp,100M,100K \
HALT,${TMPDIR},100M,1K \
HALT,${DL_DIR},100M,1K \
HALT,${SSTATE_DIR},100M,1K \
HALT,/tmp,10M,1K \
"

# standard
BUNCH_LINUX_IMAGE = "bunch-linux-minimal"
BB_GENERATE_MIRROR_TARBALLS = "1"
BOOT_DELAY = "0"
BOOT_DELAY_MS = "0"
LICENSE_FLAGS_ACCEPTED = "commercial synaptics-killswitch gpl"
IMAGE_FSTYPES = "wic"
BBMASK += " \
meta-bunch-linux/recipes-app/burger-app_git.bb \
meta-bunch-linux/recipes-app/sensors-app_git.bb \
meta-bunch-linux/recipes-dynamic/recipes-core/bunch-linux-qt6.bbappend \
meta-bunch-linux/recipes-dynamic/recipes-core/bunch-linux-qt5.bbappend \
meta-bunch-linux/recipes-dynamic/recipes-core/bunch-linux-demo.bbappend \
recipes-dynamic/recipes-qt6/qtdeviceutilities_git.bbappend \
meta-bunch-linux/recipes-graphics/env-config \
meta-bunch-linux/recipes-patch \
meta-bunch-linux/recipes-multimedia \
"

MACHINE ??= "bunch-raspberrypi4-64"
DISTRO ??= "bunch-linux-dist"
BBMULTICONFIG ?= ""
```

## meta-bunch-linux/conf/machine/bunch-linux-machine.conf
```bitbake
require conf/machine/raspberrypi4-64.conf
RPI_KERNEL_DEVICETREE_OVERLAYS += "overlays/bcm2711-rpi-4-b-active-buzzer.dtbo"
RPI_KERNEL_DEVICETREE_OVERLAYS += "overlays/bcm2711-rpi-4-b-passive-buzzer.dtbo"
```

## meta-bunch-linux/wic/rauc-sdimage-raspberrypi.wks
```
# short-description: Create Bunch Linux Pi SD card image with A/B update slots.
# Boot files are located in the first vfat partition.

# Boot partition - 256MB per firmware e kernel
part /boot --source bootimg-partition --ondisk mmcblk0 --fstype=vfat --label boot --active --align 4096 --size 256

# Root filesystem A - primary slot (10GB)
part / --source rootfs --ondisk mmcblk0 --fstype=ext4 --label rootfs.0 --align 4096 --size 10240

# Root filesystem B - secondary slot (10GB, same size as A)
part --source rootfs --ondisk mmcblk0 --fstype=ext4 --label rootfs.1 --align 4096 --size 10240

# Use MBR partition table
bootloader --ptable msdos
```
