## meta-bunch-linux/conf/distro/bunch-linux-dist.conf
```bitbake
#
# Bunch Linux Distribution Configuration (Yocto 6.0 "wrynose")
# Maintainer: Wael Karman <wael.karman@gmail.com>
#

# =============================================================================
# BASIC DISTRIBUTION INFORMATION
# =============================================================================
DISTRO = "bunch-linux-dist"
DISTRO_NAME = "Bunch Linux"
DISTRO_VERSION = "1.0.0"
DISTRO_CODENAME = "Camel"
LOCALCONF_VERSION = "2"
MAINTAINER = "Wael Karman <wael.karman@gmail.com>"

# =============================================================================
# SDK CONFIGURATION
# =============================================================================
SDK_VENDOR = "-pokysdk"
SDK_VERSION = "${@d.getVar('DISTRO_VERSION').replace('snapshot-${METADATA_REVISION}', 'snapshot')}"
SDK_VERSION[vardepvalue] = "${SDK_VERSION}"
SDK_NAME = "${DISTRO}-${TCLIBC}-${SDKMACHINE}-${IMAGE_BASENAME}-${TUNE_PKGARCH}-${MACHINE}"
SDKPATHINSTALL = "/opt/${DISTRO}/${SDK_VERSION}"

TARGET_VENDOR = "-poky"

# =============================================================================
# CONFIGURATION OPTIONS (User Configurable)
# =============================================================================
BUNCH_USE_CASE ?= "general"
BUNCH_SECURITY_LEVEL ?= "minimal"
BUNCH_DEBUG_MODE ?= "1"
BUNCH_PRODUCTION_MODE ?= "0"
BUNCH_REALTIME ?= "0"
BUNCH_ENABLE_GRAPHICS ?= "1"
BUNCH_ENABLE_ALL_FEATURES ?= "1"

# Role of wlan0:
#   "client" - joins a Wi-Fi network (secrets/wpa_supplicant-wlan0.conf)
#   "ap"     - hotspot routed through WireGuard (secrets/hotspot.psk, wg0.conf)
BUNCH_WLAN_MODE ?= "client"

# Local secrets (keys, passwords, VPN config), never committed: secrets/README.md
BUNCH_SECRETS_DIR ??= "${TOPDIR}/../secrets"

# =============================================================================
# INIT SYSTEM
# =============================================================================
INIT_MANAGER = "systemd"

# =============================================================================
# HARDWARE CONFIGURATION
# =============================================================================
ENABLE_UART = "${@bb.utils.contains('BUNCH_DEBUG_MODE', '1', '1', '0', d)}"

# Kernel selection
PREFERRED_PROVIDER_virtual/kernel = "${@bb.utils.contains('BUNCH_REALTIME', '1', 'linux-raspberrypi-rt', 'linux-raspberrypi', d)}"
PREFERRED_VERSION_linux-raspberrypi = "6.12.%"
PREFERRED_VERSION_linux-raspberrypi-rt = "6.12.%"

# The A/B boot script loads /boot/${KERNEL_IMAGETYPE} from the active rootfs
# slot: install a version-less name for the kernel image.
KERNEL_IMAGETYPE_SYMLINK = "1"

hostname:pn-base-files = "bunch-linux-dev"

# =============================================================================
# DISTRO FEATURES CONFIGURATION
# =============================================================================

# Core features: always present
BUNCH_CORE_FEATURES = "ptest multiarch usrmerge rauc"

# Graphics features: Wayland + OpenGL + EGL/DRM/GBM stack
BUNCH_GRAPHICS_FEATURES = "${@bb.utils.contains('BUNCH_ENABLE_GRAPHICS', '1', 'wayland opengl egl drm gbm', '', d)}"

# Security features, incremental by level.
# NOTE: ima/tpm2 need meta-security, selinux needs meta-selinux.
BUNCH_SECURITY_FEATURES = "${@bb.utils.contains('BUNCH_SECURITY_LEVEL', 'standard', 'pam', '', d)}"
BUNCH_SECURITY_FEATURES += "${@bb.utils.contains('BUNCH_SECURITY_LEVEL', 'high', 'pam ima tpm2', '', d)}"
BUNCH_SECURITY_FEATURES += "${@bb.utils.contains('BUNCH_SECURITY_LEVEL', 'paranoid', 'pam ima tpm2 selinux', '', d)}"

# Use case features
BUNCH_MULTIMEDIA_FEATURES = "alsa pulseaudio"
BUNCH_IOT_FEATURES = "bluetooth wifi"
BUNCH_NETWORKING_FEATURES = "ipv6 nfs"

BUNCH_USECASE_FEATURES = "${@bb.utils.contains('BUNCH_USE_CASE', 'general', '${BUNCH_MULTIMEDIA_FEATURES} ${BUNCH_IOT_FEATURES}', '', d)}"
BUNCH_USECASE_FEATURES += "${@bb.utils.contains('BUNCH_USE_CASE', 'multimedia', '${BUNCH_MULTIMEDIA_FEATURES}', '', d)}"
BUNCH_USECASE_FEATURES += "${@bb.utils.contains('BUNCH_USE_CASE', 'iot', '${BUNCH_IOT_FEATURES}', '', d)}"
BUNCH_USECASE_FEATURES += "${@bb.utils.contains('BUNCH_USE_CASE', 'server', '${BUNCH_NETWORKING_FEATURES}', '', d)}"

# Kernel cmdline debug: only in debug mode
BUNCH_KERNEL_DEBUG = "${@bb.utils.contains('BUNCH_DEBUG_MODE', '1', 'console=ttyS0,115200 console=tty1 loglevel=8', '', d)}"
CMDLINE:append = " ${BUNCH_KERNEL_DEBUG}"

# rm_work only in production, so it does not get in the way of debugging
INHERIT += "${@bb.utils.contains('BUNCH_PRODUCTION_MODE', '1', 'rm_work', '', d)}"

# =============================================================================
# FINAL DISTRO FEATURES
# =============================================================================
# :append keeps the defaults set by oe-core (DISTRO_FEATURES_DEFAULTS).
DISTRO_FEATURES:append = " ${BUNCH_CORE_FEATURES}"
DISTRO_FEATURES:append = " ${BUNCH_GRAPHICS_FEATURES}"
DISTRO_FEATURES:append = " ${BUNCH_SECURITY_FEATURES}"
DISTRO_FEATURES:append = " ${BUNCH_USECASE_FEATURES}"
DISTRO_FEATURES:remove = "x11 ${@bb.utils.contains('BUNCH_PRODUCTION_MODE', '1', 'ptest', '', d)}"

# =============================================================================
# IMAGE FEATURES (used by the image recipes)
# =============================================================================
# Development conveniences: root without password, root login over SSH,
# debuggers and profilers. Never in production.
BUNCH_DEBUG_IMAGE_FEATURES = "${@'allow-empty-password allow-root-login empty-root-password post-install-logging tools-debug tools-profile' \
    if d.getVar('BUNCH_DEBUG_MODE') == '1' and d.getVar('BUNCH_PRODUCTION_MODE') != '1' else ''}"

BUNCH_OPTIONAL_IMAGE_FEATURES = "${@bb.utils.contains('BUNCH_ENABLE_ALL_FEATURES', '1', 'ssh-server-openssh tools-sdk package-management', '', d)}"

BUNCH_IMAGE_FEATURES = "${BUNCH_OPTIONAL_IMAGE_FEATURES} ${BUNCH_DEBUG_IMAGE_FEATURES}"

# =============================================================================
# PACKAGE CONFIGURATION
# =============================================================================
POKY_DEFAULT_EXTRA_RDEPENDS = "packagegroup-core-boot"
POKY_DEFAULT_EXTRA_RRECOMMENDS = "kernel-module-af-packet"

DISTRO_EXTRA_RDEPENDS += "base-files"
DISTRO_EXTRA_RDEPENDS += "${POKY_DEFAULT_EXTRA_RDEPENDS}"
DISTRO_EXTRA_RRECOMMENDS += "${POKY_DEFAULT_EXTRA_RRECOMMENDS}"

# =============================================================================
# OPTIMIZATION SETTINGS
# =============================================================================
# Production: optimise for size (-Os); development: speed (-O2).
# DEBUG_LEVELFLAG (-g) is kept so the -dbg packages keep their symbols.
BUNCH_SIZE_OPTS = "${@bb.utils.contains('BUNCH_PRODUCTION_MODE', '1', '-Os', '-O2', d)}"
FULL_OPTIMIZATION = "${BUNCH_SIZE_OPTS} ${DEBUG_LEVELFLAG}"

# =============================================================================
# QUALITY ASSURANCE
# =============================================================================
SANITY_TESTED_DISTROS ?= " \
            ubuntu-22.04 \n \
            ubuntu-24.04 \n \
            ubuntu-25.10 \n \
            ubuntu-26.04 \n \
            debian-12 \n \
            debian-13 \n \
            fedora-43 \n \
            "

# In production some warnings become errors
WARN_TO_ERROR_QA = "${@bb.utils.contains('BUNCH_PRODUCTION_MODE', '1', 'unsafe-references-in-binaries', '', d)}"
WARN_QA:remove = "${WARN_TO_ERROR_QA}"
ERROR_QA:append = " ${WARN_TO_ERROR_QA}"

# =============================================================================
# BUILD SYSTEM CONFIGURATION
# =============================================================================
BB_SIGNATURE_HANDLER ?= "OEEquivHash"
BB_HASHSERVE ??= "auto"

INHERIT += "poky-sanity"
INHERIT += "${@bb.utils.contains('BUNCH_SECURITY_LEVEL', 'high', 'create-spdx', '', d)}"

# =============================================================================
# REQUIRED INCLUDES
# =============================================================================
# no-static-libs, security_flags, yocto-uninative and the uninative class
# come from oe-core's defaultsetup.conf.
require conf/distro/include/poky-world-exclude.inc
```
